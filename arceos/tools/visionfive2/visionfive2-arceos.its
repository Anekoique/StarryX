## arceos/tools/visionfive2/visionfive2-arceos.its
```
/*
 * U-Boot uImage source file with multiple kernels, ramdisks and FDT blobs
 */

/dts-v1/;

/ {
	description = "U-Boot uImage source file for StarryX vf2";
	#address-cells = <1>;

	images {
		kernel {
            description = "Linux kernel for StarryX";
            data = /incbin/("../../kernel-qemu.bin");
            type = "kernel";
            arch = "riscv";
            os = "linux";
            compression = "none";
            load = <0x80200000>;
            entry = <0x80200000>;
        };

		fdt {
            description = "Flattened Device Tree blob for StarryX";
            data = /incbin/("jh7110-starfive-visionfive-2-v1.3b.dtb");
            type = "flat_dt";
            arch = "riscv";
            compression = "none";
        };

	};
    configurations {
        default = "conf";
        conf {
            description = "Boot Linux kernel with FDT blob";
            kernel = "kernel";
            fdt = "fdt";
        };
    };
};
```
